## meta-mcxiv/conf/distro/mcxiv-os.conf
```bitbake
# Inherit Poky configuration as a base
require ${TOPDIR}/../layers/poky/meta-poky/conf/distro/poky.conf

DISTRO = "mcxiv-os"
DISTRO_NAME = "MCXIV OS"
DISTRO_VERSION = "1.0"
DISTROOVERRIDES = "mcxiv-os"

DISTRO_FEATURES:append = " virtualization"
DISTRO_FEATURES:append = " systemd "

PACKAGE_CLASSES = "package_ipk"
INIT_MANAGER = "systemd"
IMAGE_FEATURES:append = " ssh-server-openssh debug-tweaks"
```

## meta-mcxiv/conf/layer.conf
```bitbake
# We have a conf and classes directory, add to BBPATH
BBPATH .= ":${LAYERDIR}"

# We have recipes-* directories, add to BBFILES
BBFILES += "${LAYERDIR}/recipes-*/*/*.bb \
            ${LAYERDIR}/recipes-*/*/*.bbappend"

BBFILE_COLLECTIONS += "meta-mcxiv"
BBFILE_PATTERN_meta-mcxiv = "^${LAYERDIR}/"
BBFILE_PRIORITY_meta-mcxiv = "6"

LAYERDEPENDS_meta-mcxiv = "core"
LAYERSERIES_COMPAT_meta-mcxiv = "scarthgap"
```
